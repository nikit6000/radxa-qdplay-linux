## drivers/net/wireless/aic/Kconfig
```kconfig
config WLAN_VENDOR_AIC
	bool "AIC wireless Support"
	default y
	help
	  This is support for aic wireless chip.

config AIC_FW_PATH
	depends on WLAN_VENDOR_AIC
	string "Firmware & config file path"
	default "/vendor/etc/firmware/aic_sdio"
	help
	  Path to the firmware & config file.

if WLAN_VENDOR_AIC
source "drivers/net/wireless/aic/aic8800_fdrv/Kconfig"
source "drivers/net/wireless/aic/aic8800_btlpm/Kconfig"
endif
```
